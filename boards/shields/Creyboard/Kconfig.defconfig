## boards/shields/Creyboard/Kconfig.defconfig
```kconfig
# Copyright (c) 2023 The ZMK Contributors
# SPDX-License-Identifier: MIT

if SHIELD_CREYBOARD

config ZMK_KEYBOARD_NAME
    default "Creyboard"

endif
```

## config/boards/shields/creyboard/Kconfig.shield
```kconfig
# Copyright (c) 2023 The ZMK Contributors
# SPDX-License-Identifier: MIT
config SHIELD_CREYBOARD
    def_bool $(shields_list_contains,creyboard)
```
